## boards/shields/c_dux/Kconfig.defconfig
```kconfig
if SHIELD_C_DUX

config ZMK_SPLIT
	default y

endif

if SHIELD_C_DUX_LEFT

config ZMK_KEYBOARD_NAME
	default "C. Dux"

endif

if SHIELD_C_DUX_REV2_LEFT

config ZMK_KEYBOARD_NAME
	default "C. Dux v2"

endif


if SHIELD_C_DUX_LEFT || SHIELD_C_DUX_REV2_LEFT

config ZMK_SPLIT_BLE_ROLE_CENTRAL
	default y

config ZMK_SPLIT_BLE_CENTRAL_BATTERY_LEVEL_PROXY
	default y

config ZMK_SPLIT_BLE_CENTRAL_BATTERY_LEVEL_FETCHING
	default y

endif
```

## boards/shields/c_dux/Kconfig.shield
```kconfig
config SHIELD_C_DUX
    bool

config SHIELD_C_DUX_LEFT
	def_bool $(shields_list_contains,c_dux_left)
    select SHIELD_C_DUX

config SHIELD_C_DUX_RIGHT
	def_bool $(shields_list_contains,c_dux_right)
    select SHIELD_C_DUX

config SHIELD_C_DUX_REV2_LEFT
    def_bool $(shields_list_contains,c_dux_rev2_left)
    select SHIELD_C_DUX

config SHIELD_C_DUX_REV2_RIGHT
    def_bool $(shields_list_contains,c_dux_rev2_right)
    select SHIELD_C_DUX
```
